/*
 * Minimal SSD1306 128x64 I2C driver, built on the bare-metal I2C1 driver
 * in wokwi_i2c.c (see that file's header comment for why HAL_I2C is not
 * used here). Text-only: a local framebuffer is drawn into with a 5x7
 * font and pushed to the panel a page at a time.
 */

#include "ssd1306.h"
#include "wokwi_i2c.h"
#include <string.h>

static uint8_t framebuffer[SSD1306_PAGES][SSD1306_WIDTH];
static uint8_t cursor_page = 0;
static uint8_t cursor_col_px = 0;

/* Diagnostic: incremented every time an I2C write to the OLED fails
 * (NACK or timeout). Read from main.cpp after SSD1306_Init() to confirm
 * the bus is actually working. Should be 0 on a healthy bus. */
uint32_t g_ssd1306_i2c_errors = 0;

/* 5x7 font, standard public-domain "glcd" bitmap set, ASCII 0x20 (space)
 * through 0x5A ('Z'). Each glyph is 5 columns; bit0 of a byte is the top
 * pixel of that column, bit6 the bottom pixel (bit7 unused). One extra
 * blank column is added after each glyph for spacing (see WriteChar). */
static const uint8_t font5x7[][5] = {
    {0x00,0x00,0x00,0x00,0x00}, /* 0x20 ' ' */
    {0x00,0x00,0x5F,0x00,0x00}, /* 0x21 '!' */
    {0x00,0x07,0x00,0x07,0x00}, /* 0x22 '"' */
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    {0x61,0x51,0x49,0x45,0x43}, /* 0x5A 'Z' */
};
#define FONT_FIRST_CHAR  0x20
#define FONT_LAST_CHAR   0x5A

static void SSD1306_WriteCommand(uint8_t cmd)
{
    uint8_t buf[2] = { 0x00, cmd };   /* control byte 0x00 = command follows */
    if (BareI2C1_Write(SSD1306_I2C_ADDR, buf, 2, 100) != HAL_OK) {
        g_ssd1306_i2c_errors++;
    }
}

static void SSD1306_WriteDataBuf(const uint8_t *data, uint16_t len)
{
    uint8_t buf[SSD1306_WIDTH + 1];   /* control byte 0x40 = data follows */
    buf[0] = 0x40;
    memcpy(&buf[1], data, len);
    if (BareI2C1_Write(SSD1306_I2C_ADDR, buf, (uint16_t)(len + 1), 100) != HAL_OK) {
        g_ssd1306_i2c_errors++;
    }
}

void SSD1306_Init(void)
{
    g_ssd1306_i2c_errors = 0;

    static const uint8_t init_cmds[] = {
        0xAE,             /* display off */
        0xD5, 0x80,       /* clock divide ratio / osc frequency */
        0xA8, 0x3F,       /* multiplex ratio = 64 (0x3F) */
        0xD3, 0x00,       /* display offset = 0 */
        0x40,             /* display start line = 0 */
        0x8D, 0x14,       /* charge pump enable */
        0x20, 0x00,       /* memory addressing mode = horizontal */
        0xA1,             /* segment remap */
        0xC8,             /* COM output scan direction, remapped */
        0xDA, 0x12,       /* COM pins hardware configuration */
        0x81, 0xCF,       /* contrast */
        0xD9, 0xF1,       /* pre-charge period */
        0xDB, 0x40,       /* VCOMH deselect level */
        0xA4,             /* resume to RAM content display */
        0xA6,             /* normal (not inverted) display */
        0xAF              /* display on */
    };

    for (uint32_t i = 0; i < sizeof(init_cmds); i++) {
        SSD1306_WriteCommand(init_cmds[i]);
    }

    SSD1306_Clear();
    SSD1306_UpdateScreen();
}

void SSD1306_Clear(void)
{
    memset(framebuffer, 0x00, sizeof(framebuffer));
    cursor_page = 0;
    cursor_col_px = 0;
}

void SSD1306_UpdateScreen(void)
{
    for (uint8_t page = 0; page < SSD1306_PAGES; page++) {
        SSD1306_WriteCommand((uint8_t)(0xB0 + page)); /* set page address */
        SSD1306_WriteCommand(0x00);                    /* lower column = 0 */
        SSD1306_WriteCommand(0x10);                    /* upper column = 0 */
        SSD1306_WriteDataBuf(framebuffer[page], SSD1306_WIDTH);
    }
}

void SSD1306_SetCursor(uint8_t page, uint8_t col)
{
    if (page >= SSD1306_PAGES) page = SSD1306_PAGES - 1;
    cursor_page = page;
    cursor_col_px = (uint8_t)(col * 6);   /* 5 px glyph + 1 px spacing */
}

void SSD1306_WriteChar(char c)
{
    if (c < FONT_FIRST_CHAR || c > FONT_LAST_CHAR) {
        c = ' ';
    }
    if (cursor_col_px > (SSD1306_WIDTH - 6)) {
        return;   /* off the right edge: silently stop (no wrap needed here) */
    }

    const uint8_t *glyph = font5x7[c - FONT_FIRST_CHAR];
    for (uint8_t i = 0; i < 5; i++) {
        framebuffer[cursor_page][cursor_col_px + i] = glyph[i];
    }
    framebuffer[cursor_page][cursor_col_px + 5] = 0x00;   /* spacing column */
    cursor_col_px = (uint8_t)(cursor_col_px + 6);
}

void SSD1306_WriteString(const char *str)
{
    while (*str) {
        SSD1306_WriteChar(*str++);
    }
}

void SSD1306_DisplayOn(void)
{
    SSD1306_WriteCommand(0xAF);
}

void SSD1306_DisplayOff(void)
{
    SSD1306_WriteCommand(0xAE);
}